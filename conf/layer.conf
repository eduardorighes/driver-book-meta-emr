## conf/layer.conf
```bitbake
# We have a conf and classes directory, add to BBPATH
BBPATH .= ":${LAYERDIR}"

# We have recipes-* directories, add to BBFILES
BBFILES += "${LAYERDIR}/recipes-*/*/*.bb \
            ${LAYERDIR}/recipes-*/*/*.bbappend"

BBFILE_COLLECTIONS += "meta-emr"
BBFILE_PATTERN_meta-emr = "^${LAYERDIR}/"
BBFILE_PRIORITY_meta-emr = "6"

LAYERDEPENDS_meta-emr = "core"
LAYERSERIES_COMPAT_meta-emr = "thud dunfell"
```
